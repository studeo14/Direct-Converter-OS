## project-spec/configs/rootfsconfigs/Kconfig.user
```kconfig
menu "user packages " 
config dmatest  
	 bool "dmatest"
	 help
	
config gpio-demo  
	 bool "gpio-demo"
	 help
	
config htmx  
	 bool "htmx"
	 help
	
config peekpoke  
	 bool "peekpoke"
	 help
	
endmenu
```
